## meta-forestscribe/conf/layer.conf
```bitbake
# We have a conf and classes directory, add to BBPATH
BBPATH .= ":${LAYERDIR}"

# We have recipes-* directories, add to BBFILES
BBFILES += "${LAYERDIR}/recipes-*/*/*.bb \
	${LAYERDIR}/recipes-*/*/*.bbappend"

BBFILE_COLLECTIONS += "forestscribe"
BBFILE_PATTERN_forestscribe = "^${LAYERDIR}/"
BBFILE_PRIORITY_forestscribe = "8"
```
